## widget_esp/main/Kconfig.projbuild
```kconfig
menu "Widget ESP32 config"

config WIDGET_DEVICE_ID
    string "Widget device ID"
    default "widget_001"
    help
        Unikalny identyfikator urządzenia. Jest używany jako prefiks topiców MQTT,
        np. <device_id>/status, <device_id>/sensor, <device_id>/command.

config WIDGET_WIFI_SSID
    string "WiFi SSID"
    default "your_wifi_ssid"

config WIDGET_WIFI_PASS
    string "WiFi password"
    default "your_wifi_password"

config WIDGET_MQTT_BROKER_URI
    string "MQTT broker URI"
    default "mqtt://192.168.0.126"
    help
        Przykłady:
        - mqtt://192.168.0.126
        - mqtt://broker.local

config WIDGET_ACTUATORS_CSV
    string "Actuators list (CSV)"
    default "led"
    help
        Lista aktywatorów oddzielona przecinkami, np. led,relay,buzzer,light_strip.

config WIDGET_EMITTERS_CSV
    string "Emitters list (CSV)"
    default "button"
    help
        Lista emiterów oddzielona przecinkami, np. button,gyro,motion,temp_sensor.

config WIDGET_STATUS_INTERVAL_MS
    int "Status publish interval (ms)"
    range 1000 60000
    default 10000

endmenu
```
